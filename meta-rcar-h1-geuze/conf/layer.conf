## meta-rcar-h1-geuze/conf/layer.conf
```bitbake
BBPATH ?= ""
# We add conf directory to BBPATH
BBPATH .= ":${LAYERDIR}"

# We have a recipes directory containing .bb and .bbappend files, add to BBFILES
BBFILES += "${LAYERDIR}/recipes-*/*/*.bb \
            ${LAYERDIR}/recipes-*/*/*.bbappend"

BBFILE_COLLECTIONS += "rcar-h1-geuze"
BBFILE_PATTERN_rcar-h1-geuze := "^${LAYERDIR}/"
BBFILE_PRIORITY_rcar-h1-geuze = "7"

# Define a similar VARIABLE to COREBASE in order to get a reference to
# top directory easily
IVI_COREBASE := '${@os.path.normpath("${LAYERDIR}/../")}'
```

## meta-rcar-h1-geuze/conf/machine/rcar-h1-geuze.conf
```bitbake
#@TYPE: Machine
#@NAME: RCAR H1 machine
#@DESCRIPTION: Machine configuration for the MARZEN / GEUZE board 

PREFERRED_PROVIDER_virtual/xserver = "xserver-xorg"

# Ship all kernel modules by default
MACHINE_EXTRA_RRECOMMENDS = " kernel-modules"

# Allow for MMC booting (required by the NAND-less)
EXTRA_IMAGEDEPENDS += "u-boot"

# Uncomment the following line to enable the hard floating point abi. Note that
# this breaks some binary libraries and 3D (neither of which ship with
# meta-yocto). For maximum compatibility, leave this disabled.
#DEFAULTTUNE ?= "cortexa8hf-neon"
include conf/machine/include/tune-cortexa9.inc

IMAGE_CLASSES += "sdcard_image_rea"

IMAGE_FSTYPES += "tar.bz2 ext3 rcar-h1-geuze-sdimg"
EXTRA_IMAGECMD_jffs2 = "-lnp "

# 2.6.37 and later kernels use OMAP_SERIAL, ttyO2
# earlier kernels use ttyS2
SERIAL_CONSOLE = "115200 ttySC2"

PREFERRED_PROVIDER_virtual/kernel ?= "linux-mainline"
PREFERRED_VERSION_linux-mainline ?= "3.4%"

PREFERRED_PROVIDER_jpeg = "jpeg"
PREFERRED_PROVIDER_jpeg-native = "jpeg-native"

KERNEL_IMAGETYPE = "uImage"

PREFERRED_VERSION_u-boot ?= "v2011.03%"

UBOOT_MACHINE = "marzen_config"
UBOOT_ENTRYPOINT = "0x60008000"
UBOOT_LOADADDRESS = "0x60008000"

MACHINE_FEATURES = "kernel26 apm usbgadget usbhost vfat alsa"
```

## meta-rcar-h1-marzen/conf/layer.conf
```bitbake
# We have a conf and classes directory, add to BBPATH
BBPATH := "${BBPATH}:${LAYERDIR}"

# We have a recipes directory, add to BBFILES
BBFILES := "${BBFILES} ${LAYERDIR}/recipes-*/*/*.bb \
	${LAYERDIR}/recipes-*/*/*.bbappend"

BBFILE_COLLECTIONS += "rcar-h1-marzen"
BBFILE_PATTERN_rcar-h1-marzen := "^${LAYERDIR}/"
BBFILE_PRIORITY_rcar-h1-marzen = "6"
```

## meta-rcar-h1-marzen/conf/machine/rcar-h1-marzen.conf
```bitbake
#@TYPE: Machine
#@NAME: rcar-h1-marzen

#@DESCRIPTION: Machine configuration for Renesas R-Car H1 Marzen systems


# Ship all kernel modules by default
MACHINE_EXTRA_RRECOMMENDS = " kernel-modules"

EXTRA_IMAGEDEPENDS += "u-boot"

include conf/machine/include/tune-cortexa9.inc

IMAGE_FSTYPES += "tar.bz2 jffs2"
EXTRA_IMAGECMD_jffs2 = "-lnp "

SERIAL_CONSOLE = "115200 ttySC2"

# Mainline kernel recipe
PREFERRED_PROVIDER_virtual/kernel ?= "linux-yocto-custom"
PREFERRED_VERSION_linux-yocto-custom ?= "3.4%"

# Yocto kernel recipe
#PREFERRED_PROVIDER_virtual/kernel ?= "linux-yocto"
#PREFERRED_VERSION_linux-yocto ?= "3.4%"

PREFERRED_VERSION_u-boot ?= "v2011.03%"

KERNEL_IMAGETYPE = "uImage"

UBOOT_MACHINE = "marzen_config"
UBOOT_ENTRYPOINT = "0x60008000"
UBOOT_LOADADDRESS = "0x60008000"

MACHINE_FEATURES = "apm usbgadget usbhost vfat alsa"
```

## meta-rcar-h2-lager/conf/layer.conf
```bitbake
BBPATH ?= ""
# We add conf directory to BBPATH
BBPATH .= ":${LAYERDIR}"

# We have a recipes directory containing .bb and .bbappend files, add to BBFILES
BBFILES += "${LAYERDIR}/recipes-*/*/*.bb \
            ${LAYERDIR}/recipes-*/*/*.bbappend"

BBFILE_COLLECTIONS += "rcar-h2-lager"
BBFILE_PATTERN_rcar-h2-lager := "^${LAYERDIR}/"
BBFILE_PRIORITY_rcar-h2-lager = "7"

# Define a similar VARIABLE to COREBASE in order to get a reference to
# top directory easily
IVI_COREBASE := '${@os.path.normpath("${LAYERDIR}/../")}'
```

## meta-rcar-h2-lager/conf/machine/rcar-h2-lager.conf
```bitbake
#@TYPE: Machine
#@NAME: RCAR H2 machine
#@DESCRIPTION: Machine configuration for the LAGER / KOELSCH board 

PREFERRED_PROVIDER_virtual/xserver = "xserver-xorg"

# Ship all kernel modules by default
MACHINE_EXTRA_RRECOMMENDS = " kernel-modules"

# Allow for MMC booting (required by the NAND-less)
EXTRA_IMAGEDEPENDS += "u-boot"

# Uncomment the following line to enable the hard floating point abi. Note that
# this breaks some binary libraries and 3D (neither of which ship with
# meta-yocto). For maximum compatibility, leave this disabled.
#DEFAULTTUNE ?= "cortexa8hf-neon"
include conf/machine/include/tune-cortexa9.inc

IMAGE_CLASSES += "sdcard_image_rea"

IMAGE_FSTYPES += "tar.bz2 ext3 rcar-h2-lager-sdimg"
EXTRA_IMAGECMD_jffs2 = "-lnp "

SERIAL_CONSOLE = "38400 ttySC6"

PREFERRED_PROVIDER_virtual/kernel ?= "linux-yocto"
PREFERRED_VERSION_linux-mainline ?= "3.4%"

PREFERRED_PROVIDER_jpeg = "jpeg"
PREFERRED_PROVIDER_jpeg-native = "jpeg-native"

KERNEL_IMAGETYPE = "uImage"

PREFERRED_VERSION_u-boot ?= "v2013.01.01%"

UBOOT_MACHINE = "lager_config"
UBOOT_ENTRYPOINT = "0x40008000"
UBOOT_LOADADDRESS = "0x40008000"

MACHINE_FEATURES = "kernel26 apm usbgadget usbhost vfat alsa"
```

## meta-renesas-ivi/conf/layer.conf
```bitbake
BBPATH ?= ""
# We add conf directory to BBPATH
BBPATH .= ":${LAYERDIR}"

# We have a recipes directory containing .bb and .bbappend files, add to BBFILES
BBFILES += "${LAYERDIR}/recipes-*/*/*.bb \
            ${LAYERDIR}/recipes-*/*/*.bbappend"

BBFILE_COLLECTIONS += "rea"
BBFILE_PATTERN_rea := "^${LAYERDIR}/"
BBFILE_PRIORITY_rea = "7"

# Define a similar VARIABLE to COREBASE in order to get a reference to
# top directory easily
IVI_COREBASE := '${@os.path.normpath("${LAYERDIR}/../")}'
```
